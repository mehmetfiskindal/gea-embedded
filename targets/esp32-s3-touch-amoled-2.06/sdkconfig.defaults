## targets/esp32-s3-touch-amoled-2.06/sdkconfig.defaults
```kconfig
# Target: ESP32-S3
CONFIG_IDF_TARGET="esp32s3"

# Flash: 32 MB (Waveshare ESP32-S3-Touch-AMOLED-2.06)
CONFIG_ESPTOOLPY_FLASHSIZE_32MB=y

# Allow bootloader cache-mapped reads from 32-bit SPI flash addresses. This is
# required for bootable app partitions above 16 MB on the board's DIO flash.
CONFIG_IDF_EXPERIMENTAL_FEATURES=y
CONFIG_BOOTLOADER_CACHE_32BIT_ADDR_QUAD_FLASH=y

# Console over USB Serial/JTAG (native USB-C on this board)
CONFIG_ESP_CONSOLE_USB_SERIAL_JTAG=y

# esp_codec_dev should share the existing new-driver I2C bus with touch/PMIC.
# CONFIG_CODEC_I2C_BACKWARD_COMPATIBLE is not set

# Disable secondary console to avoid duplicate output
CONFIG_ESP_CONSOLE_SECONDARY_NONE=y

# FreeRTOS tick rate — 1000 Hz gives 1 ms resolution for modMilliseconds
CONFIG_FREERTOS_HZ=1000

# Main task stack for the app/XS entrypoint. Keep this modest so BLE HID apps
# have enough internal DRAM to link.
CONFIG_ESP_MAIN_TASK_STACK_SIZE=16384

# Wi-Fi scan/connect callbacks run on ESP-IDF's system event task.
CONFIG_ESP_SYSTEM_EVENT_TASK_STACK_SIZE=4096

# Custom partition table with two OTA slots for wireless updates
CONFIG_PARTITION_TABLE_CUSTOM=y
CONFIG_PARTITION_TABLE_CUSTOM_FILENAME="partitions.csv"

# On panic: print backtrace and halt (keeps USB alive for reflashing)
CONFIG_ESP_SYSTEM_PANIC_PRINT_HALT=y

# Enable octal PSRAM for framebuffer
CONFIG_SPIRAM=y
CONFIG_SPIRAM_MODE_OCT=y
CONFIG_SPIRAM_SPEED_80M=y
CONFIG_SPIRAM_ALLOW_BSS_SEG_EXTERNAL_MEMORY=y
CONFIG_SPIRAM_TRY_ALLOCATE_WIFI_LWIP=y

# Wi-Fi/LwIP memory budget: prefer lower throughput over internal DRAM pressure.
CONFIG_ESP_WIFI_STATIC_RX_BUFFER_NUM=8
CONFIG_ESP_WIFI_DYNAMIC_RX_BUFFER_NUM=16
CONFIG_ESP_WIFI_STATIC_TX_BUFFER_NUM=8
CONFIG_ESP_WIFI_CACHE_TX_BUFFER_NUM=8
CONFIG_ESP_WIFI_MGMT_SBUF_NUM=16
CONFIG_ESP_WIFI_RX_BA_WIN=8
# CONFIG_ESP_WIFI_IRAM_OPT is not set
# CONFIG_ESP_WIFI_RX_IRAM_OPT is not set

# Firmware uses STA mode for OTA/log/mirror; trim unused Wi-Fi/LwIP features.
# CONFIG_ESP_WIFI_SOFTAP_SUPPORT is not set
# CONFIG_ESP_WIFI_ENTERPRISE_SUPPORT is not set
# CONFIG_ESP_WIFI_ENABLE_WPA3_SAE is not set
# CONFIG_ESP_WIFI_ENABLE_WPA3_OWE_STA is not set
# CONFIG_LWIP_IPV6 is not set
# CONFIG_LWIP_DHCPS is not set

# Bluetooth: NimBLE peripheral for BLE HID
CONFIG_BT_ENABLED=y
CONFIG_BT_NIMBLE_ENABLED=y
CONFIG_BT_NIMBLE_MEM_ALLOC_MODE_EXTERNAL=y
CONFIG_BT_NIMBLE_MAX_CONNECTIONS=1
CONFIG_BT_NIMBLE_ROLE_BROADCASTER=y
CONFIG_BT_NIMBLE_ROLE_PERIPHERAL=y
CONFIG_BT_NIMBLE_ROLE_CENTRAL=n
CONFIG_BT_NIMBLE_ROLE_OBSERVER=n
CONFIG_BT_NIMBLE_SM_LEGACY=y
CONFIG_BT_NIMBLE_SM_SC=y
CONFIG_BT_NIMBLE_NVS_PERSIST=y
CONFIG_BT_NIMBLE_LOG_LEVEL_NONE=y
```
